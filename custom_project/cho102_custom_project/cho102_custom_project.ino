#include <Keypad.h>
#include <U8glib.h>

#define backlight_pin 11

typedef struct task {
  int state;
  unsigned long period;
  unsigned long elapsedTime;
  int (*TickFct)(int);
    
} task;

int delay_gcd;
const unsigned short tasksNum = 4;
task tasks[tasksNum];

// Constants for row and column sizes
const byte ROWS = 4;
const byte COLS = 3;
 
// Array to represent keys on keypad
char hexaKeys[ROWS][COLS] = {
  {'1', '2', '3'},
  {'4', '5', '6'},
  {'7', '8', '9'},
  {'*', '0', '#'}
};

// Keypad Connections to Arduino
byte rowPins[ROWS] = {A0, A1, A2, A3};
byte colPins[COLS] = {A4, A5, 13};

//Keypad Object 
Keypad keypad = Keypad(makeKeymap(hexaKeys), rowPins, colPins, ROWS, COLS);

bool timerOn, setupMode = false;
int inputKey, timerVal, moveVal, countdown, displayVal;
double initVal;
enum SM1_States {SM1_INIT, ENTER_VAL, CHECK_VAL, TIMER_START};
int SM1_Tick(int state){
    switch(state){ // State transitions
    case SM1_INIT:
        if(!timerOn){state = ENTER_VAL; setupMode = true;
        Serial.print("\nSM1: entered enterval from init");}
    break;
    case ENTER_VAL:
        if(inputKey == 42){
            state = TIMER_START;
            Serial.print("\nSM1: entered timer start from enterval");
        }
    break;
    case TIMER_START:
        state = SM1_INIT;
        setupMode = false;
        Serial.print("\nSM1: entered init from timer start");
    break;
    }
    switch(state){ // State Action
    case SM1_INIT:
    // displayVal = 0;
    timerVal = 0;
    moveVal = 1;
    break;
    case ENTER_VAL:
    inputKey = keypad.getKey();
    if (inputKey) {
        if(inputKey != 42){
            if(inputKey == 35){
                timerVal = 0;
            }
            else{
                timerVal = (timerVal * moveVal) + (inputKey-48);
            }
            moveVal = 10;
        }
    }
    break;
    case TIMER_START:
    timerOn = true;
    displayVal = timerVal;
    countdown = timerVal*60;
    initVal = countdown;
    break;
    }

    return state;
}

bool motionSensed, check, distanceCheck,isSuccess;
int halfwayPoint, cnt;
const int trigPin = 2;
const int echoPin = 3;
long duration;
int distance;
enum SM2_States {SM2_INIT, TIMER_ON, TIMER_PAUSE, TIMER_OFF, SUCCESS_WAIT};
int SM2_Tick(int state){
    switch(state){ // State transitions
    case SM2_INIT:
    if(timerOn){
        halfwayPoint = countdown/2;
        state = TIMER_ON;
        Serial.print("\nSM2: entered timer on from init");
    }
    break;
    case TIMER_ON:
    if (countdown == halfwayPoint){
        check = true;
        distanceCheck = true;
        state = TIMER_PAUSE;
        Serial.print("\nSM2: entered timer pause from timer on");
    }
    if(countdown <= 0){
        isSuccess = true;
        state = SUCCESS_WAIT;
        Serial.print("\nSM2: entered success wait from timer on");
    }
    break;
    case TIMER_PAUSE:
    if(motionSensed){distanceCheck = false; check = false; state = TIMER_ON;
    Serial.print("\nSM2: entered timer on from pause");}
    if(cnt == 20){state = SM2_INIT;Serial.print("\nSM3: entered init on from pause");}
    break;
    case TIMER_OFF:
    state = SM2_INIT;
    Serial.print("\nSM2: entered init from timer off");
    break;
    case SUCCESS_WAIT:
        inputKey = keypad.getKey();
        if(inputKey == 42){
            state = TIMER_OFF;
            isSuccess = false;
            Serial.print("\nSM2: entered timer off from success wait");
        }
    break;
    }
    switch(state){ // State Action
    case SM2_INIT:
    isSuccess = false;
    break;
    case TIMER_ON:
    if(countdown%60 == 0){
        --displayVal;
    }
    countdown--;
    break;
    case TIMER_PAUSE:
    break;
    case TIMER_OFF:
    timerOn = false;
    setupMode = true;
    break;
    case SUCCESS_WAIT:
    break;
    }
    return state;
}

int checkpointCounter = 0;
bool failDisplay;
const int buzzer = 12;
enum SM3_States {SM3_INIT, CHECKPOINT, FAIL};
int SM3_Tick(int state){
    switch(state){ // State transitions
    case SM3_INIT:
    if(check){state = CHECKPOINT;Serial.print("\nSM3: entered checkpoint from init");}
    break;
    case CHECKPOINT:
    if(!motionSensed && checkpointCounter >= 20){check = false; failDisplay = true; state = FAIL;Serial.print("\nSM3: entered fail from checkpoint");}
    if(motionSensed){state = SM3_INIT;Serial.print("\nSM3: entered init from checkpoint");}
    break;
    case FAIL:
    if(cnt == 20){state = SM3_INIT;timerOn = false; setupMode = true;Serial.print("\nSM3: entered init from fail");}
    break;
    }

    switch(state){ // State Action
    case SM3_INIT:
    cnt = 0;
    noTone(buzzer);
    motionSensed = false;
    checkpointCounter = 0;
    failDisplay = false;
    break;
    case CHECKPOINT:
    for(int i = 0; i < 5;++i){
        tone(buzzer,311.13);
    }
    noTone(buzzer);
    // Clears the trigPin
    digitalWrite(trigPin, LOW);
    delayMicroseconds(2);
    // Sets the trigPin on HIGH state for 10 micro seconds
    digitalWrite(trigPin, HIGH);
    delayMicroseconds(10);
    digitalWrite(trigPin, LOW);
    // Reads the echoPin, returns the sound wave travel time in microseconds
    duration = pulseIn(echoPin, HIGH);
    // Calculating the distance
    distance = duration * 0.034 / 2;
    if(distance < 50){motionSensed = true;} 
    else {motionSensed = false;}
    ++checkpointCounter;
    break;
    case FAIL:
    //buzzer sound
    tone(buzzer, 493.88);
    ++cnt;
    break;
    }
    return state;
}


U8GLIB_PCD8544 u8g(8, 4, 7, 5, 6);  // CLK=8, DIN=4, CE=7, DC=5, RST=6
const uint8_t L100C[] PROGMEM = {
0x00, 0x00, 0x00, 0x00, 0x00, 0x00, 0x00, 0x00, 0x00, 0x00, 0x00, 0x00, 0x00, 0x00, 0x00, 0x00,
0x00, 0x00, 0x00, 0x00, 0x00, 0x00, 0x00, 0x00, 0x00, 0x00, 0x00, 0x00, 0x00, 0x00, 0x00, 0x00,
0x07, 0xC0, 0x00, 0x00, 0x00, 0x00, 0x0F, 0xE0, 0x00, 0x00, 0x00, 0x00, 0x0C, 0xE3, 0xF0, 0x00,
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0x00, 0x00, 0x00, 0x00, 0x00, 0x00, 0x01, 0x02, 
};

const uint8_t L0C[] PROGMEM = {
  0x00, 0x00, 0x00, 0x00, 0x00, 0x00, 0x00, 0x00, 0x00, 0x00, 0x00, 0x00, 0x00, 0x00, 0x00, 0x00,
0x00, 0x00, 0x00, 0x00, 0x00, 0x00, 0x00, 0x00, 0x00, 0x00, 0x00, 0x00, 0x00, 0x00, 0x00, 0x00,
0x00, 0x00, 0x00, 0x00, 0x00, 0x00, 0x00, 0x00, 0x00, 0x00, 0x00, 0x00, 0x00, 0x00, 0x00, 0x00,
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0x00, 0x00, 0x00, 0x00, 0x00, 0x00, 0x01, 0x02, 
};

const uint8_t L20C[] PROGMEM = {
0x00, 0x00, 0x00, 0x00, 0x00, 0x00, 0x00, 0x00, 0x00, 0x00, 0x00, 0x00, 0x00, 0x00, 0x00, 0x00,
0x00, 0x00, 0x00, 0x00, 0x00, 0x00, 0x00, 0x00, 0x00, 0x00, 0x00, 0x00, 0x00, 0x00, 0x00, 0x00,
0x00, 0x00, 0x00, 0x00, 0x00, 0x00, 0x00, 0x00, 0x00, 0x00, 0x00, 0x00, 0x00, 0x00, 0x00, 0x00,
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0x42, 0x38, 0x7B, 0xEA, 0x86, 0xB2, 0x28, 0xC7, 
};

const uint8_t L40C[] PROGMEM = {
0x00, 0x00, 0x00, 0x00, 0x00, 0x00, 0x00, 0x00, 0x00, 0x00, 0x00, 0x00, 0x00, 0x00, 0x00, 0x00,
0x00, 0x00, 0x00, 0x00, 0x00, 0x00, 0x00, 0x00, 0x00, 0x00, 0x00, 0x00, 0x00, 0x00, 0x00, 0x00,
0x00, 0x00, 0x00, 0x00, 0x00, 0x00, 0x00, 0x00, 0x00, 0x00, 0x00, 0x00, 0x00, 0x00, 0x00, 0x00,
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0xEC, 0x12, 0xC8, 0x47, 0x80, 0xFB, 0x2B, 0x4A, 
};

const uint8_t L50C[] PROGMEM = {
00, 0x00, 0x00, 0x00, 0x00, 0x00, 0x00, 0x00, 0x00, 0x00, 0x00, 0x00, 0x00, 0x00, 0x00, 0x00,
0x00, 0x00, 0x00, 0x00, 0x00, 0x00, 0x00, 0x00, 0x00, 0x00, 0x00, 0x00, 0x00, 0x00, 0x00, 0x00,
0x00, 0x00, 0x00, 0x00, 0x00, 0x00, 0x00, 0x00, 0x00, 0x00, 0x00, 0x00, 0x00, 0x00, 0x00, 0x00,
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0xCF, 0x0E, 0xB8, 0xB1, 0xE2, 0xEF, 0xD9, 0xDB, 
};

const uint8_t L60C[] PROGMEM = {
0x00, 0x00, 0x00, 0x00, 0x00, 0x00, 0x00, 0x00, 0x00, 0x00, 0x00, 0x00, 0x00, 0x00, 0x00, 0x00,
0x00, 0x00, 0x00, 0x00, 0x00, 0x00, 0x00, 0x00, 0x00, 0x00, 0x00, 0x00, 0x00, 0x00, 0x00, 0x00,
0x00, 0x00, 0x00, 0x00, 0x00, 0x00, 0x00, 0x00, 0x00, 0x00, 0x00, 0x00, 0x00, 0x00, 0x00, 0x00,
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0x74, 0x15, 0xBF, 0xBC, 0x9A, 0x3F, 0x0F, 0x55, 
};

const uint8_t L80C[] PROGMEM = {
0x00, 0x00, 0x00, 0x00, 0x00, 0x00, 0x00, 0x00, 0x00, 0x00, 0x00, 0x00, 0x00, 0x00, 0x00, 0x00,
0x00, 0x00, 0x00, 0x00, 0x00, 0x00, 0x00, 0x00, 0x00, 0x00, 0x00, 0x00, 0x00, 0x00, 0x00, 0x00,
0x00, 0x00, 0x00, 0x00, 0x00, 0x00, 0x00, 0x00, 0x00, 0x00, 0x00, 0x00, 0x00, 0x00, 0x00, 0x00,
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0x48, 0x80, 0xE6, 0xE6, 0xC0, 0x5E, 0xCF, 0xF3, 
};

const uint8_t FAILC[] PROGMEM = {
0x00, 0x00, 0x00, 0x00, 0x00, 0x00, 0x00, 0x00, 0x00, 0x00, 0x00, 0x00, 0x00, 0x00, 0x00, 0x00,
0x00, 0x00, 0x00, 0x00, 0x00, 0x00, 0x00, 0x00, 0x00, 0x00, 0x00, 0x00, 0x00, 0x00, 0x00, 0x00,
0x00, 0x00, 0x00, 0x00, 0x00, 0x00, 0x00, 0x00, 0x00, 0x00, 0x00, 0x00, 0x00, 0x00, 0x00, 0x00,
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0x5F, 0x9E, 
};


void drawSetup(void) {
  u8g.setFont(u8g_font_profont11);  // select font
  u8g.drawStr(10, 10, "Enter Time");
  u8g.drawStr(10, 20, "in Minutes");
  u8g.drawStr(0, 40, "Input: ");
  u8g.setPrintPos(50, 40);
  u8g.print(timerVal);
  }

void drawMain(void) {
    if(((initVal-countdown)/initVal) == 1){
        u8g.drawBitmapP( 37, 0, 6, 50, L100C);
    }
    else if(((initVal-countdown)/initVal) >= 0.8){
        u8g.drawBitmapP( 37, 0, 6, 50, L80C);
    }
    else if(((initVal-countdown)/initVal) >= 0.6){
        u8g.drawBitmapP( 37, 0, 6, 50, L60C);
    }
    else if((((initVal-countdown)/initVal) == 0.5) && !failDisplay){
        u8g.drawStr(37, 10, "CHECK");
        u8g.drawStr(37, 20, "SENSOR!");
        u8g.drawBitmapP( 37, 0, 6, 50, L50C);
    }
    else if((((initVal-countdown)/initVal) == 0.5) && failDisplay){
        u8g.drawBitmapP( 37, 0, 6, 49, FAILC);
    }
    else if(((initVal-countdown)/initVal) >= 0.4){
        u8g.drawBitmapP( 37, 0, 6, 50, L40C);
    }
    else if(((initVal-countdown)/initVal) >= 0.2){
        u8g.drawBitmapP( 37, 0, 6, 50, L20C);
    }
    else{
        u8g.drawBitmapP( 37, 0, 6, 50, L0C);
    }

    if(failDisplay){
        u8g.setFont(u8g_font_profont11);  // select font
        u8g.drawStr(0, 20, "FAIL!");
    }
    else if(isSuccess){
        u8g.setFont(u8g_font_profont11);  // select font
        u8g.drawStr(0, 20, "SUCCESS!");        
    }
    else{
        u8g.setFont(u8g_font_profont11);  // select font
        u8g.drawStr(0, 20, "M: ");
        u8g.setPrintPos(15, 20);
        u8g.print(displayVal);
        u8g.drawStr(0, 30, "S: ");
        u8g.setPrintPos(15, 30);
        u8g.print(countdown%60);
    }
}

enum SM4_States {SM4_INIT, SETUP, DRAWING};
int SM4_Tick(int state){
    switch(state){
        case SM4_INIT:
        if(setupMode){state = SETUP;Serial.print("\nSM4: entered setup from init");}
        break;
        case SETUP:
        if(!setupMode){state = DRAWING;Serial.print("\nSM4: entered drawing from setup");}
        break;
        case DRAWING:
        if(setupMode){state = SETUP;Serial.print("\nSM4: entered setup from drawing");}
        break;
    }
    switch(state){
        case SM4_INIT:
        break;
        case SETUP:
        u8g.firstPage();  
        do {
            drawSetup();
        } while( u8g.nextPage() );
        break;
        case DRAWING:
        u8g.firstPage();  
        do {
            drawMain();
        } while( u8g.nextPage() );              
        break;
    }
    return state;
}

void setup() {
    analogWrite(backlight_pin, 50);  //Sets the Backlight intensity
    pinMode(trigPin, OUTPUT); // Sets the trigPin as an Output
    pinMode(echoPin, INPUT); // Sets the echoPin as an Input
    Serial.begin(9600);

    unsigned char i = 0;
    //KEYPAD INPUT
    tasks[i].state = SM1_INIT;
    tasks[i].period = 100;
    tasks[i].elapsedTime = 0;
    tasks[i].TickFct = &SM1_Tick;
    i++;
    //TIMER
    tasks[i].state = SM2_INIT;
    tasks[i].period = 1000;
    tasks[i].elapsedTime = 0;
    tasks[i].TickFct = &SM2_Tick;
    i++;
    //SENSOR & CHECKPOINT & BUZZER
    tasks[i].state = SM3_INIT;
    tasks[i].period = 1000;
    tasks[i].elapsedTime = 0;
    tasks[i].TickFct = &SM3_Tick;
    i++;
    //LCD DISPLAY
    tasks[i].state = SM4_INIT;
    tasks[i].period = 1000;
    tasks[i].elapsedTime = 0;
    tasks[i].TickFct = &SM4_Tick;

    // delay_gcd = 500; // GCD

}

void loop() {
  // put your main code here, to run repeatedly:
  unsigned char i;
  for (i = 0; i < tasksNum; ++i) {
     if ( (millis() - tasks[i].elapsedTime) >= tasks[i].period) {
        tasks[i].state = tasks[i].TickFct(tasks[i].state);
        tasks[i].elapsedTime = millis(); // Last time this task was ran
      
     }
   }
}
